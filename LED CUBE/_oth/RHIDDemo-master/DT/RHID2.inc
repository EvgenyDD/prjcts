        db  6h,  0h, ffh           ; USAGE_PAGE (Generic Desktop)
        db  9h,  1h                ; USAGE (Vendor Usage 1)
        db a1h,  1h                ; COLLECTION (Application)
        db 85h,  1h                ;   REPORT_ID (1)
        db  9h,  1h                ;   USAGE (Vendor Usage 1)
        db 15h,  0h                ;   LOGICAL_MINIMUM (0)
        db 25h,  1h                ;   LOGICAL_MAXIMUM (1)
        db 75h,  8h                ;   REPORT_SIZE (8)
        db 95h,  1h                ;   REPORT_COUNT (1)
        db b1h, 82h                ;   FEATURE (Data,Var,Abs,Vol)
        db 85h,  1h                ;   REPORT_ID (1)
        db  9h,  1h                ;   USAGE (Vendor Usage 1)
        db 91h, 82h                ;   OUTPUT (Data,Var,Abs,Vol)
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        db 95h,  1h                ;   REPORT_COUNT (1)
        db b1h, 82h                ;   FEATURE (Data,Var,Abs,Vol)
        db 85h,  2h                ;   REPORT_ID (2)
        db  9h,  2h                ;   USAGE (Vendor Usage 2)
        db 91h, 82h                ;   OUTPUT (Data,Var,Abs,Vol)
        db 85h,  3h                ;   REPORT_ID (3)
        db  9h,  3h                ;   USAGE (Vendor Usage 3)
        db 15h,  0h                ;   LOGICAL_MINIMUM (0)
        db 26h, ffh,  0h           ;   LOGICAL_MAXIMUM (255)
        db 75h, 40h                ;   REPORT_SIZE (64)
        db 95h,  1h                ;   REPORT_COUNT (1)
        db b1h, 82h                ;   FEATURE (Data,Var,Abs,Vol)
        db 85h,  3h                ;   REPORT_ID (3)
        db  9h,  3h                ;   USAGE (Vendor Usage 3)
        db 91h, 82h                ;   OUTPUT (Data,Var,Abs,Vol)
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        db 75h,  1h                ;   REPORT_SIZE (1)
        db b1h, 82h                ;   FEATURE (Data,Var,Abs,Vol)
        db 75h,  7h                ;   REPORT_SIZE (7)
        db 81h, 83h                ;   INPUT (Cnst,Var,Abs,Vol)
        db 85h,  5h                ;   REPORT_ID (5)
        db 75h,  7h                ;   REPORT_SIZE (7)
        db b1h, 83h                ;   FEATURE (Cnst,Var,Abs,Vol)
        db 85h,  6h                ;   REPORT_ID (6)
        db  9h,  6h                ;   USAGE (Vendor Usage 6)
        db 15h,  0h                ;   LOGICAL_MINIMUM (0)
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        db 75h,  1h                ;   REPORT_SIZE (1)
        db b1h, 82h                ;   FEATURE (Data,Var,Abs,Vol)
        db 75h,  7h                ;   REPORT_SIZE (7)
        db 81h, 83h                ;   INPUT (Cnst,Var,Abs,Vol)
        db 85h,  6h                ;   REPORT_ID (6)
        db 75h,  7h                ;   REPORT_SIZE (7)
        db b1h, 83h                ;   FEATURE (Cnst,Var,Abs,Vol)
        db c0h                     ; END_COLLECTION
